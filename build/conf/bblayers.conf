## build/conf/bblayers.conf
```bitbake
# POKY_BBLAYERS_CONF_VERSION is increased each time build/conf/bblayers.conf
# changes incompatibly
POKY_BBLAYERS_CONF_VERSION = "2"

BBPATH = "${TOPDIR}"
BBFILES ?= ""

BBLAYERS ?= " \
  /home/shooresh/yocto/poky/meta \
  /home/shooresh/yocto/poky/meta-poky \
  /home/shooresh/yocto/poky/meta-yocto-bsp \
  /home/shooresh/yocto/poky/meta-openembedded/meta-oe \
  /home/shooresh/yocto/poky/meta-openembedded/meta-python \
  /home/shooresh/yocto/poky/meta-openembedded/meta-filesystems \
  /home/shooresh/yocto/poky/meta-openembedded/meta-networking \
  /home/shooresh/yocto/poky/meta-security \
  /home/shooresh/yocto/poky/meta-virtualization \
  /home/shooresh/yocto/poky/meta-sh \
  "
```

## meta-sh/conf/layer.conf
```bitbake
# We have a conf and classes directory, add to BBPATH
BBPATH .= ":${LAYERDIR}"

# We have recipes-* directories, add to BBFILES
BBFILES += "${LAYERDIR}/recipes-*/*/*.bb \
            ${LAYERDIR}/recipes-*/*/*.bbappend"

BBFILE_COLLECTIONS += "meta-sh"
BBFILE_PATTERN_meta-sh = "^${LAYERDIR}/"
BBFILE_PRIORITY_meta-sh = "6"

# Add paths for extra files
#FILESEXTRAPATHS:prepend := "${LAYERDIR}/recipes-support/startup/files:"
#FILESEXTRAPATHS:prepend := "${LAYERDIR}/recipes-web/web-ui/files:"

LAYERDEPENDS_meta-sh = "core"
LAYERSERIES_COMPAT_meta-sh = "styhead"

# Specify the image type - tar.bz2 wic iso
IMAGE_FSTYPES += "ext4"
```

## old-meta-shs/conf/layer.conf
```bitbake
BBPATH .= ":${LAYERDIR}"
BBFILES += "${LAYERDIR}/recipes-*/*/*.bb"

# Ensure compatibility with your Yocto version
LAYERSERIES_COMPAT_meta-shs = "styhead"

# Add paths for extra files
FILESEXTRAPATHS:prepend := "${LAYERDIR}/recipes-support/startup/files:"
FILESEXTRAPATHS:prepend := "${LAYERDIR}/recipes-web/web-ui/files:"
```
